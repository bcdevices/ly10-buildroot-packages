## acsccid_ly/Config.in
```kconfig
config BR2_PACKAGE_ACSCCID_LY
	bool "acsccid_ly"
	depends on BR2_TOOLCHAIN_HAS_THREADS # libusb
	select BR2_PACKAGE_FLEX
	select BR2_PACKAGE_LIBUSB
	select BR2_PACKAGE_LIBUSB_COMPAT
	select BR2_PACKAGE_PCSC_LITE
	help
	  ACS CCID PC/SC Driver for Linux/Mac OS X

	  https://github.com/acshk/acsccid

comment "acsccid needs a toolchain w/ threads"
	depends on !BR2_TOOLCHAIN_HAS_THREADS
```

## openocd_maxim/Config.in
```kconfig
config BR2_PACKAGE_OPENOCD_MAXIM
        bool "openocd_maxim"
        depends on BR2_TOOLCHAIN_HAS_THREADS #
        select BR2_PACKAGE_LIBUSB
        select BR2_PACKAGE_LIBUSB_COMPAT
        select BR2_PACKAGE_LIBFTDI
        select BR2_PACKAGE_HIDAPI
        help
           OpenOCD for Zephyr
```

## package/openssh_ly/Config.in
```kconfig
config BR2_PACKAGE_OPENSSH_LY
	bool "openssh"
	depends on BR2_USE_MMU # fork()
	select BR2_PACKAGE_OPENSSL
	select BR2_PACKAGE_ZLIB
	help
	  A free version of the SSH protocol suite of network
	  connectivity tools. The standard 'ssh', 'sshd', 'scp', and
	  friends.

	  http://www.openssh.com/

if BR2_PACKAGE_OPENSSH_LY

config BR2_PACKAGE_OPENSSH_LY_CLIENT
	bool "client"
	default y
	help
	  Client programs: ssh, scp, sftp, ssh-agent, ssh-add,
	  ssh-copy-id.

config BR2_PACKAGE_OPENSSH_LY_SERVER
	bool "server"
	default y
	help
	  Server programs: sshd, sftp-server

config BR2_PACKAGE_OPENSSH_LY_KEY_UTILS
	bool "key utilities"
	default y
	help
	  Key utilities: ssh-keygen, ssh-keyscan.

endif
```

## plymouth/Config.in
```kconfig
config BR2_PACKAGE_PLYMOUTH
  bool "plymouth"
  help
    Plymouth is a project from Fedora providing a flicker-free graphical boot process.
  select BR2_PACKAGE_FREETYPE
  select BR2_PACKAGE_LIBPNG
  select BR2_PACKAGE_XKEYBOARD_CONFIG
```

## python-capstone/Config.in
```kconfig
config BR2_PACKAGE_PYTHON_CAPSTONE
	bool "python-capstone"
	help
	  Capstone disassembly engine.

	  https://www.capstone-engine.org
```

## python-cmsis-pack-manager/Config.in
```kconfig
config BR2_PACKAGE_PYTHON_CMSIS_PACK_MANAGER
	bool "python-cmsis-pack-manager"
	help
  	Python manager for CMSIS-Pack index and cache with fast Rust backend
```

## python-importlib-metadata/Config.in
```kconfig
config BR2_PACKAGE_PYTHON_IMPORTLIB_METADATA
	bool "python-importlib-metadata"
  select BR2_PACKAGE_PYTHON_ZIPP # runtime
```

## python-importlib-resources/Config.in
```kconfig
config BR2_PACKAGE_PYTHON_IMPORTLIB_RESOURCES
	bool "python-importlib-resources"
```

## python-natsort/Config.in
```kconfig
config BR2_PACKAGE_PYTHON_NATSORT
	bool "python-natsort"
	help
	  Simple yet flexible natural sorting in Python.

	  https://github.com/SethMMorton/natsort
```

## python-naturalsort/Config.in
```kconfig
config BR2_PACKAGE_PYTHON_NATURALSORT
	bool "python-naturalsort"
	help
	  Simple natural order sorting API for Python.

	  https://github.com/xolox/python-naturalsort
```

## python-prettytable/Config.in
```kconfig
config BR2_PACKAGE_PYTHON_PRETTYTABLE
	bool "python-prettytable"
	select BR2_PACKAGE_PYTHON_WCWIDTH # runtime
	help
	  A simple Python library for easily displaying tabular data in a visually appealing ASCII table format
```

## python-pyocd-pemicro/Config.in
```kconfig
config BR2_PACKAGE_PYTHON_PYOCD_PEMICRO
	bool "python-pyocd-pemicro"
	select BR2_PACKAGE_PYTHON_PYPEMICRO # runtime
	help
		PyOCD debug probe plugin for PEMicro debug probes
```

## python-pyocd/Config.in
```kconfig
config BR2_PACKAGE_PYTHON_PYOCD
	bool "python-pyocd"
  select BR2_PACKAGE_PYTHON_CAPSTONE # runtime
  select BR2_PACKAGE_PYTHON_CMSIS_PACK_MANAGER # runtime
  select BR2_PACKAGE_PYTHON_COLORAMA # runtime
  select BR2_PACKAGE_PYTHON_HIDAPI # runtime
  # select BR2_PACKAGE_PYTHON_IMPORTLIB_METADATA #runtime
  # select BR2_PACKAGE_PYTHON_IMPORTLIB_RESOURCES #runtime
  select BR2_PACKAGE_PYTHON_INTELHEX # runtime
  select BR2_PACKAGE_PYTHON_INTERVALTREE # runtime
  select BR2_PACKAGE_PYTHON_LARK # runtime
  select BR2_PACKAGE_PYTHON_LIBUSB_PACKAGE # runtime
  select BR2_PACKAGE_PYTHON_NATSORT # runtime
  select BR2_PACKAGE_PYTHON_PRETTYTABLE # runtime
  select BR2_PACKAGE_PYTHON_PYELFTOOLS # runtime
  select BR2_PACKAGE_PYTHON_PYLINK_SQUARE # runtime
  select BR2_PACKAGE_PYTHON_PYUSB # runtime
  select BR2_PACKAGE_PYTHON_PYYAML # runtime
  select BR2_PACKAGE_PYTHON_TYPING_EXTENSION # runtime
  select BR2_PACKAGE_PYTHON_SIX # runtime
	help
	  Cortex-M debugger for Python.

	  https://github.com/pyocd/pyOCD
```

## python-pypemicro/Config.in
```kconfig
config BR2_PACKAGE_PYTHON_PYPEMICRO
	bool "python-pypemicro"
	help
   	Python tool to control PEMicro Debug probes
```

## python-sortedcontainers/Config.in
```kconfig
config BR2_PACKAGE_PYTHON_SORTEDCONTAINERS
	bool "python-sortedcontainers"
	help
	  Sorted Containers -- Sorted List, Sorted Dict, Sorted Set.

	  http://www.grantjenks.com/docs/sortedcontainers/
```
